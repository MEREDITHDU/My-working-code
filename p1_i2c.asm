SCL			EQU		P3.1
SDA			EQU		P3.0
	
TH0_INIT	EQU		232
T0_DV_INIT	EQU		100	

TH1_INIT	EQU		251

DSEG		AT		30H
T0_DV:		DS		1
CLOCK:


CSEG		AT		0H
CL_HC:		DBIT	1
RESET:
	AJMP	INIT_SYSTEM
	;Wektory przerwan
ORG 0003H
	AJMP	INT0_ISR
ORG 000BH
	AJMP	T0_ISR
ORG 0013H
	AJMP	INT1_ISR
ORG 001BH
	AJMP	T1_ISR
ORG 0023H
	AJMP	UART_ISR
ORG 002BH
	AJMP	T2_ISR

INIT_SYSTEM:
CLR_MEM:
	MOV		R7,#120;
	MOV		R0,#8
	MOV		A,#0;
CLR_MEM_LP:
	MOV		@R0,A
	INC		R0
	DJNZ	R7,CLR_MEM_LP

INIT_STACK:
	MOV		SP,#7Fh	
	
	MOV		P1,#0FEh
	MOV		P3,#0FEh

	
INIT_TIMER:
	MOV		TH0,#TH0_INIT
	MOV		TH1,#TH1_INIT
	MOV		T0_DV,#T0_DV_INIT
	MOV		TMOD,#11H
	MOV		TCON,#50H
	MOV     IE,#8AH
	
CLOCK_INC:	
	MOV		A,@R0
	ADD		A,#1
	DA		A
	CJNE	A,#60H,CLOCK_EX
	CLR		A
	MOV		@R0,A
	INC		R0
	MOV		A,@R0
	ADD		A,#1
	DA		A
	CJNE	A,#60H,CLOCK_EX
	CLR		A
	MOV		@R0,A
	INC		R0
	MOV		A,@R0
	ADD		A,#1
	DA		A
	CJNE	A,#24H,CLOCK_EX
	CLR		A
CLOCK_EX:
	MOV		@R0,A
	SETB	CL_HC
	RET
	
SYS_INIT:
	P1DIR EQU 96H
	
	MOV   	P1DIR,#0FFH
	MOV		SP,#7FH
	MOV		P1,#0FEh
	MOV 	DPTR,#TO_7SEG	
	MOV		R2,#0
	
MAIN:	
	MOV		A,R2
	INC		A
	CJNE	A,#10,VAL_OK
	CLR		A
VAL_OK:
	MOV		R2,A
	MOVC 	A,@A+DPTR
	MOV		P1,A		
	ACALL	DELAY	
	SJMP	MAIN
	
	SJMP	$
		
DELAY:		
	MOV		R6,#120
	MOV		R7,#0
DY_LP:
	DJNZ	R7,DY_LP
	DJNZ	R6,DY_LP
	RET


TO_7SEG:
	DB 01111011B;0
	DB 01000001B;1
	DB 00110111B;2
	DB 01100111B;3
	DB 01001101B;4
	DB 01101110B;5
	DB 01111110B;6
	DB 01000011B;7
    DB 01111111B;8
	DB 01101111B;9
	
	
RESET2:
	MOV		SP,#7FH	
	ACALL	I2C_START
	MOV		A,#4EH
	ACALL	I2C_WRITE
	MOV		A,#0FfH
	ACALL	I2C_WRITE
	ACALL	I2C_STOP

LOOP:
	ACALL	I2C_START
	MOV		A,#04FH
	ACALL	I2C_WRITE
	CLR		F0
	ACALL	I2C_READ
	MOV		P0,A
	ACALL	I2C_STOP	
	SJMP	LOOP
		
		
I2C_START:
	CLR		SDA
	NOP
	NOP
	NOP
	NOP
	CLR		SCL
	NOP
	NOP	
	RET


I2C_STOP:
	SETB	SCL
	NOP
	NOP
	NOP
	NOP
	SETB	SDA
	RET
	
I2C_WRITE:
	MOV		R7,#8
I2C_W_LP:	
	RLC		A
	MOV		SDA,C
	NOP
	NOP
	NOP
	NOP
	SETB	SCL
	NOP
	NOP
	NOP
	NOP
	CLR		SCL
	NOP	
	DJNZ	R7,I2C_W_LP
	SETB	SDA
	NOP
	NOP
	NOP
	NOP
	SETB	SCL
	NOP
	NOP
	NOP
	MOV		C,SDA
	CLR		SCL
	RET


I2C_READ:
	MOV		R7,#8
I2C_R_LP:
	SETB	SCL
	NOP
	NOP
	NOP
	NOP
	MOV		C,SDA	
	CLR		SCL
	RLC		A
	NOP
	NOP
	NOP
	DJNZ	R7,I2C_R_LP
	MOV		C,F0
	MOV		SDA,C
	NOP
	NOP
	NOP
	SETB	SCL
	NOP
	NOP
	NOP
	CLR		SCL
	RET




T0_ISR:
	MOV		TH0,#TH0_INIT
	PUSH	PSW
	PUSH	ACC	
	SETB	RS0
T0_ISR_BODY:
	MOV		T0_DV,#T0_DV_INIT
	MOV		R0,#CLOCK
	ACALL	CLOCK_INC
	SETB	CL_HC

T0_ISR_EX:
	POP		ACC
	POP		PSW
	RETI
T1_ISR:	
	MOV		TH1,#TH1_INIT
	PUSH	PSW
	PUSH    ACC	
	PUSH    DPL
	PUSH 	DPH
	SETB	RS0
	MOV 	P1,#0FFh
T1_ISR_BODY:
	
T1_ISR_EX:	
	POP 	DPH
	POP 	DPL
	POP 	ACC	
	POP 	PSW
	RETI


INT0_ISR:
INT1_ISR:
UART_ISR:
T2_ISR:
	RETI
	
	

END